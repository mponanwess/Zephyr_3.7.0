## manifest/west.yml
```yaml
manifest:
  remotes:
    - name: zephyrproject-rtos
      url-base: https://github.com/zephyrproject-rtos

    # add remotes here

  projects:
    - name: zephyr
      remote: zephyrproject-rtos
      revision: v3.7.0
      import: true
      path: zephyr

    # add projects here

  self:
    path: .
```
